## system/cfengine/Kconfig
```kconfig
config SYSTEM_CFAGENT
	tristate "cfagent"
	default n

if SYSTEM_CFAGENT

config SYSTEM_CFAGENT_PROGNAME
	string "Program name"
	default "cfagent"

config SYSTEM_CFAGENT_PRIORITY
	int "cfagent task priority"
	default 100

config SYSTEM_CFAGENT_STACKSIZE
	int "cfagent stack size"
	default DEFAULT_TASK_STACKSIZE

endif
```
